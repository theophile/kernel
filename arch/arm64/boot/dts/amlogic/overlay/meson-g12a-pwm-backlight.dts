/dts-v1/;
/plugin/;

#include <dt-bindings/gpio/gpio.h>
#include <dt-bindings/gpio/meson-g12a-gpio.h>

/ {
        compatible = "radxa,zero", "amlogic,g12a";

        fragment@0 {
                target-path = "/";
                __overlay__ {
                       backlight: backlight {
                               compatible = "pwm-backlight";
                               power-supply = <&vddao_3v3>;
                               enable-gpios = <&gpio_ao GPIOAO_10 GPIO_ACTIVE_HIGH>;
                               pwms = <&pwm_AO_ab 0 1000000 0>;
                               brightness-levels = <0 255>;
                               num-interpolated-steps = <255>;
                               default-brightness-level = <255>;
                               status = "okay";
                       };
               };
       };
};
